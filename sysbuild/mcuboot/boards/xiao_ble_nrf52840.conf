## sysbuild/mcuboot/boards/xiao_ble_nrf52840.conf
```kconfig
# Disable MCUboot and OTA features since XIAO uses its own pre-flashed Adafruit UF2 Bootloader
CONFIG_BOOTLOADER_MCUBOOT=n
CONFIG_MCUMGR=n
CONFIG_IMG_MANAGER=n

# Output UF2 file for drag-and-drop flashing
CONFIG_BUILD_OUTPUT_UF2=y

# Enable USB Subsystem (XIAO BLE relies on native USB CDC for serial, it lacks a J-Link)
CONFIG_USB_DEVICE_STACK=y
CONFIG_USB_DEVICE_INITIALIZE_AT_BOOT=y
CONFIG_SERIAL=y
CONFIG_CONSOLE=y
CONFIG_UART_CONSOLE=y
CONFIG_UART_LINE_CTRL=y
CONFIG_UART_INTERRUPT_DRIVEN=y

# Fix multiple definition error by explicitly disabling the NEXT generation USB stack
# The XIAO BLE board's default dts/kconfig pulls in the new experimental stack, 
# which clashes with the standard Zephyr USB CDC stack we enable.
CONFIG_USB_DEVICE_STACK_NEXT=n
```
